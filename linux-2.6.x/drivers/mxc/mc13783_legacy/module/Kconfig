## linux-2.6.x/drivers/mxc/mc13783_legacy/module/Kconfig
```kconfig
#
# Character device configuration
#

config MXC_MC13783_ADC
	tristate "mc13783 ADC support"
	depends on MXC_MC13783_PMIC || MXC_MC13783_LEGACY
	---help---
	This is the mc13783 ADC module driver. This module provides kernel API
	for the ADC system of mc13783.
	It controls also the touch screen interface.
	If you want mc13783 ADC support, you should say Y here

config MXC_MC13783_AUDIO
	tristate "mc13783 Audio support"
	depends on MXC_MC13783_PMIC || MXC_MC13783_LEGACY
	---help---
	This is the mc13783 audio module driver. This module provides kernel API
	for audio part of mc13783.
	If you want mc13783 audio support, you should say Y here
config MXC_MC13783_RTC
	tristate "mc13783 Real Time Clock (RTC) support"
	depends on MXC_MC13783_PMIC || MXC_MC13783_LEGACY
	---help---
	This is the mc13783 RTC module driver. This module provides kernel API
	for RTC part of mc13783.
	If you want mc13783 RTC support, you should say Y here
config MXC_MC13783_LIGHT
	tristate "mc13783 Light and Backlight support"
	depends on MXC_MC13783_PMIC || MXC_MC13783_LEGACY
	---help---
	This is the mc13783 Light module driver. This module provides kernel API
	for led and backlight control part of mc13783.
	If you want mc13783 Light support, you should say Y here
config MXC_MC13783_BATTERY
	tristate "mc13783 Battery API support"
	depends on MXC_MC13783_PMIC || MXC_MC13783_LEGACY
	---help---
	This is the mc13783 battery module driver. This module provides kernel API
	for battery control part of mc13783.
	If you want mc13783 battery support, you should say Y here
config MXC_MC13783_CONNECTIVITY
	tristate "mc13783 Connectivity API support"
	depends on MXC_MC13783_PMIC ||  MXC_MC13783_LEGACY
	---help---
	This is the mc13783 connectivity module driver. This module provides kernel API
	for USB/RS232 connectivity control part of mc13783.
	If you want mc13783 connectivity support, you should say Y here
config MXC_MC13783_POWER
	tristate "mc13783 Power API support"
	depends on MXC_MC13783_PMIC || MXC_MC13783_LEGACY
	---help---
	This is the mc13783 power and supplies module driver. This module provides kernel API
	for power and regulator control part of mc13783.
	If you want mc13783 power support, you should say Y here
```

## linux-2.6.x/drivers/mxc/pm/Kconfig
```kconfig
#
# Power Managment devices
#

menu "Advanced Power Management devices"

config MXC_DPTC
	bool "MXC DPTC driver"
	depends on (ARCH_MX3 || ARCH_MXC91331 || ARCH_MXC91321) && MXC_MC13783_LEGACY
	default y
	help
	   This selects the Freescale MXC Internal DPTC driver.
	   If unsure, say N.

config MXC_DVFS
	bool "MXC DVFS driver"
	depends on ARCH_MX3
	default y
	help
	  This selects the Freescale MXC Internal DVFS driver.
	  If unsure, say N.

config MXC_DVFS_SDMA
	bool "MXC DVFS SDMA support"
	depends on MXC_DVFS
	default n
	help
	  This selects the Freescale MXC Internal DVFS driver SDMA support.
	  If unsure, say N.

endmenu
```

## linux-2.6.x/drivers/mxc/sc55112/core/Kconfig
```kconfig
#
# PMIC sc55112 device configuration
#

menu "SC55112 support"

config MXC_PMIC_SC55112
        tristate "sc55112 core support"
        ---help---
          This is the sc55112 protocol driver for the Freescale MXC application.
          You must also use the 'MXC SPI support' option with this.
config MXC_PMIC_SC55112_FIXARB
        bool "Use Arbitration Bit Workaround"
        depends on MXC_PMIC_SC55112
        default n
        ---help---
            Enable this option to include the code that will automatically
            toggle the sc55112 arbitration bits to allow register write
            access to the secondary processor. Note that this also requires
            a hardware modification to the RF Deck that connects the Sphinx
            card (with the sc55112 PMIC) to the MXC91131 EVB.

source "drivers/mxc/sc55112/module/Kconfig"

endmenu
```

## linux-2.6.x/drivers/mxc/sc55112/module/Kconfig
```kconfig
#
# PMIC sc55112 client modules
#

config MXC_PMIC_SC55112_CONNECTIVITY
        tristate "sc55112 USB/RS-232 connectivity support"
        depends on MXC_PMIC_SC55112
        ---help---
          This is the sc55112 connectivity client driver that provides
          support for handling USB (or USB On-the-Go) and RS-232 connections
          with external peripherals. Note that the sc55112 PMIC ADC driver
          must also be selected in order to build and use the connectivity
          driver.

config MXC_PMIC_SC55112_AUDIO
        tristate "sc55112 audio support"
        depends on MXC_PMIC_SC55112
        ---help---
          This is the sc55112 audio client driver that provides support
          for the audio CODECs, amplifier, and mixer hardware. This driver
          is required to provide audio recording and playback using the
          sc55112.

config MXC_PMIC_SC55112_ADC
        tristate "sc55112 ADC support"
        depends on MXC_PMIC_SC55112
        ---help---
        This is the sc55112 ADC module driver. This module provides kernel API
        for the ADC system of sc55112.
        It controls also the touch screen interface.
        If you want sc55112 ADC support, you should say Y here

config MXC_PMIC_SC55112_BATTERY
	tristate "sc55112 Battery support"
	depends on MXC_PMIC_SC55112
	---help---
	This is the sc55112 Battery module driver. This module provides kernel
	API for the Battery system of sc55112.
	If you want sc55112 Battery support, you should say Y here


config MXC_PMIC_SC55112_LIGHT
	tristate "sc55112 Light support"
	depends on MXC_PMIC_SC55112
	---help---
	This is the sc55112 Light module driver. This module provides kernel
	API for the backlight and tri-color LED system of sc55112.
	If you want sc55112 Light support, you should say Y here

config MXC_PMIC_SC55112_POWER
	tristate "sc55112 Power Control support"
	depends on MXC_PMIC_SC55112
	---help---
	This is the sc55112 Power Control module driver. This module provides
	kernel API for the Power Control system of sc55112.
	If you want sc55112 Power Control support, you should say Y here
```

## linux-2.6.x/drivers/mxc/sdma/Kconfig
```kconfig
#
# SDMA modules
#

menu "SDMA"

config MXC_SDMA_API
	bool "Use SDMA API"
	depends on ARCH_MXC
	default y
	help
	  This selects the Freescale MXC SDMA API.
	  If unsure, say N.

endmenu
```

## linux-2.6.x/drivers/mxc/security/Kconfig
```kconfig
menu "MXC Security Drivers"

config MXC_SECURITY_SCC
	tristate "MXC SCC Driver"
	depends on ARCH_MXC
	default n
	---help---
	  This module contains the core API's for accessing the SCC module.
	  If you are unsure about this, say N here.

config MXC_SECURITY_RNGA
	tristate "MXC RNGA Driver"
	depends on ARCH_MXC
	depends on !ARCH_MXC91321
	default n
	select MXC_SECURITY_CORE
	---help---
	  This module contains the core API's for accessing the RNGA module.
	  If you are unsure about this, say N here.

config MXC_RNGA_TEST_DEBUG
	bool "MXC RNGA module debugging"
	depends on MXC_SECURITY_RNGA
	default n
	---help---
	  This is an option for use by developers; most people should
	  say N here.  This enables RNGA module debugging.

config MXC_SECURITY_HAC
	tristate "MXC HAC Driver"
	depends on ARCH_MXC
	depends on !ARCH_MXC91321
	depends on !ARCH_MX3
	default n
	select MXC_SECURITY_CORE
	---help---
	  This module contains the core API's for accessing the HAC module.
	  If you are unsure about this, say N here.

config MXC_HAC_TEST_DEBUG
	bool "MXC HAC Module debugging"
	depends on MXC_SECURITY_HAC
	---help---
        This is an option for use by developers; most people should
        say N here.  This enables HAC module debugging.

config MXC_SECURITY_RTIC
	tristate "MXC RTIC Driver"
	depends on ARCH_MXC
	depends on !ARCH_MXC91131
	default n
	select MXC_SECURITY_CORE
	---help---
	  This module contains the core API's for accessing the RTIC module.
	  If you are unsure about this, say N here.

config MXC_RTIC_TEST_DEBUG
	bool "MXC RTIC module debugging"
	depends on MXC_SECURITY_RTIC
	default n
	---help---
	  This is an option for use by developers; most people should
	  say N here.  This enables RTIC module debugging.

config MXC_SECURITY_CORE
	tristate

if (ARCH_MXC91231 || ARCH_MXC91321) && MXC_SECURITY_RNGA=n && MXC_SECURITY_HAC=n
source "drivers/mxc/security/sahara2/Kconfig"
endif

endmenu
```

## linux-2.6.x/drivers/mxc/spi/Kconfig
```kconfig
#
# SPI device configuration
#

menu "MXC SPI support"

config MXC_SPI
	tristate "SPI support"
	---help---
	  Say Y to get the SPI services API available on MXC platform. 

config MXC_SPI_SELECT1
	bool "CSPI1"
	depends on MXC_SPI
	default y

config MXC_SPI_SELECT2
	bool "CSPI2"
	depends on MXC_SPI
	default y

config MXC_SPI_SELECT3
	bool "CSPI3"
	depends on MXC_SPI && ARCH_MX3
	default n

endmenu
```

## linux-2.6.x/drivers/otg/Kconfig
```kconfig
# @(#) balden@seth2.belcarratech.com|otg/.Makefiles/Kconfig-mxc|20051116204956|34435
# Copyright (c) 2004 Belcarra Technologies Corp
#
#                      Copyright (c) 2006 Motorola, Inc. 
#
# Changelog:
# Date               Author           Comment
# -----------------------------------------------------------------------------
# 08/09/2006         Motorola         Initial distribution
# 10/18/2006         Motorola         Add Open Src Software language
# 12/12/2006         Motorola         Changes for Open Src compliance.
#
# This Program is distributed in the hope that it will
# be useful, but WITHOUT ANY WARRANTY;
# without even the implied warranty of
# MERCHANTIBILITY or FITNESS FOR A
# PARTICULAR PURPOSE.  See the GNU
# General Public License for more details.

# This program is free software; you can redistribute it
# and/or modify it under the terms of the GNU General
# Public License as published by the Free Software
# Foundation; either version 2 of the License, or (at
# your option) any later version.  You should have
# received a copy of the GNU General Public License
# along with this program; if not, write to the Free
# Software Foundation, Inc., 675 Mass Ave,
# Cambridge, MA 02139, USA

menu "On-The-Go and USB Peripheral Support"

    config OTG
        tristate "Support for On-The-Go and USB Peripheral Support"
        ---help---
            Configure all or part of the Belcarra OTG Stack

    config OTG_HIGH_SPEED
	bool "Enable HS USB"
	depends on OTG
	default n
	---help---
		This enables HS USB in the OTG Stack.

    config OTG_NFS
	bool "Enable NFS"
	depends on OTG
	default n
	---help---
		This enables NFS in the OTG Stack.
    comment ""

    menu "On-The-Go Support Platform Selection"
        depends on OTG 

       # source "drivers/otg/ocd/scma11ref/Kconfig"
        source "drivers/otg/ocd/brassboard/Kconfig"
       # source "drivers/otg/ocd/zasevb/Kconfig"
       # source "drivers/otg/ocd/isp1301/Kconfig"

    endmenu

    source "drivers/otg/Kconfig-otg"

    menu "Targeted Peripherals List (USB Peripheral Function Drivers)"
        depends on OTG_PLATFORM_OTG || OTG_PLATFORM_USBD
        #---help---
        #A list of USB peripheral types that this device
        #can emulate when it is acting as a peripheral.
        source "drivers/otg/functions/generic/Kconfig"
        source "drivers/otg/functions/acm/Kconfig"
#        source "drivers/otg/functions/mouse/Kconfig"
        source "drivers/otg/functions/msc/Kconfig"
        source "drivers/otg/functions/network/Kconfig"
#        source "drivers/otg/functions/isotest/Kconfig"
        source "drivers/otg/functions/mtp/Kconfig"
    endmenu


endmenu
```

## linux-2.6.x/drivers/otg/functions/acm/Kconfig
```kconfig
# @(#) balden@seth2.belcarratech.com|otg/functions/acm/Kconfig|20051116204957|31621
#
#      Copyright 2006 Motorola, Inc.
#
# Changelog:
# Date               Author           Comment
# -----------------------------------------------------------------------------
# 01/17/2006         Motorola         Initial distribution
# 10/18/2006         Motorola         Add Open Src Software language 
# 12/11/2006         Motorola         Changes for Open src compliance.
#
# This Program is distributed in the hope that it will
# be useful, but WITHOUT ANY WARRANTY;
# without even the implied warranty of
# MERCHANTIBILITY or FITNESS FOR A
# PARTICULAR PURPOSE.  See the GNU
# General Public License for more details.

# This program is free software; you can redistribute it
# and/or modify it under the terms of the GNU General
# Public License as published by the Free Software
# Foundation; either version 2 of the License, or (at
# your option) any later version.  You should have
# received a copy of the GNU General Public License
# along with this program; if not, write to the Free
# Software Foundation, Inc., 675 Mass Ave,
# Cambridge, MA 02139, USA

menu "OTG ACM Function"

config OTG_ACM
         tristate "  CDC ACM Function"
         depends on OTG

menu "OTG ACM function options"
	depends on OTG && OTG_ACM

config OTG_ACM_VENDORID
        hex "VendorID (hex value)"
	depends on OTG_ACM && OTG
        default "0x15ec"

config OTG_ACM_PRODUCTID
	depends on OTG_ACM && OTG
        hex "ProductID (hex value)"
        default "0xf002"
config OTG_ACM_BCDDEVICE
	depends on OTG_ACM && OTG
        hex "bcdDevice (binary-coded decimal)"
        default "0x0100"

config OTG_ACM_MANUFACTURER
	depends on OTG_ACM && OTG
        string "iManufacturer (string)"
        default "Belcarra"

config OTG_ACM_PRODUCT_NAME
	depends on OTG_ACM && OTG
        string "iProduct (string)"
        default "Belcarra ACM Device"

config OTG_ACM_DESC
	depends on OTG_ACM && OTG
        string "iConfiguration (string)"
        default "Acm Cfg"

config OTG_ACM_HOTPLUG
	depends on OTG_ACM && OTG
	bool "start acm hotplug"
        default TRUE

config OTG_ACM_COMM_INTF
	depends on OTG_ACM && OTG
        string "Comm Interface iInterface (string)"
        default "Comm Intf"

config OTG_ACM_NODATA_INTF
	depends on OTG_ACM && OTG
        string "No Data Interface iInterface (string)"
        default "NoData Intf"

config OTG_ACM_DATA_INTF
	depends on OTG_ACM && OTG
        string "Data Interface iInterface (string)"
        default "Data Intf"

config OTG_ACM_CONSOLE
        depends on OTG_ACM && OTG
        bool "Start console on ACM"
        default FALSE

endmenu
endmenu

#menu "OTG MCPC Function"
#
#config OTG_MCPC
#         tristate "  CDC MCPC Function"
#         depends on OTG
#
#menu "OTG MCPC function options"
#	depends on OTG && OTG_MCPC
#
#config OTG_MCPC_VENDORID
#        hex "VendorID (hex value)"
#	depends on OTG_MCPC && OTG
#        default "0x15ec"
#
#config OTG_MCPC_PRODUCTID
#	depends on OTG_MCPC && OTG
#        hex "ProductID (hex value)"
#        default "0xf007"
#config OTG_MCPC_BCDDEVICE
#	depends on OTG_MCPC && OTG
#        hex "bcdDevice (binary-coded decimal)"
#        default "0x0100"
#
#config OTG_MCPC_MANUFACTURER
#	depends on OTG_MCPC && OTG
#        string "iManufacturer (string)"
#        default "Belcarra"
#
#config OTG_MCPC_PRODUCT_NAME
#	depends on OTG_MCPC && OTG
#        string "iProduct (string)"
#        default "Belcarra MCPC Device"
#
#config OTG_MCPC_DESC
#	depends on OTG_MCPC && OTG
#        string "iConfiguration (string)"
#        default "Acm Cfg"
#
#config OTG_MCPC_COMM_INTF
#	depends on OTG_MCPC && OTG
#        string "Comm Interface iInterface (string)"
#        default "Comm Intf"
#
#config OTG_MCPC_DATA_INTF
#	depends on OTG_MCPC && OTG
#        string "Data Interface iInterface (string)"
#        default "Data Intf"
#
#endmenu
#endmenu
```
