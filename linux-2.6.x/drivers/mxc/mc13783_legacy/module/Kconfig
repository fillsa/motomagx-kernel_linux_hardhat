## linux-2.6.x/drivers/otg/functions/msc/Kconfig
```kconfig
# @(#) balden@seth2.belcarratech.com|otg/functions/msc/Kconfig|20051116204958|16988
#
# Copyright (c) 2006 - 2007 Motorola, Inc.
#
# Changelog:
# Date               Author           Comment
# -----------------------------------------------------------------------------
# 03/16/2006         Motorola         Initial distribution 
# 10/18/2006         Motorola         Add Open Src Software language
# 12/11/2006         Motorola         Changes for Open src compliance.
# 03/07/2007         Motorola         Changes for 32K Transfer rate.
# 08/24/2007         Motorola         Changes for Open src compliance.
#
# This Program is distributed in the hope that it will
# be useful, but WITHOUT ANY WARRANTY;
# without even the implied warranty of
# MERCHANTIBILITY or FITNESS FOR A
# PARTICULAR PURPOSE.  See the GNU
# General Public License for more details.

# This program is free software; you can redistribute it
# and/or modify it under the terms of the GNU General
# Public License as published by the Free Software
# Foundation; either version 2 of the License, or (at
# your option) any later version.  You should have
# received a copy of the GNU General Public License
# along with this program; if not, write to the Free
# Software Foundation, Inc., 675 Mass Ave,
# Cambridge, MA 02139, USA

menu "OTG Mass Storage function"
	depends on OTG

config OTG_MSC
        tristate "  Mass Storage Function"
        depends on OTG

menu "OTG Mass Storage function options"
	depends on OTG && OTG_MSC

config OTG_MSC_VENDORID
        hex "VendorID (hex value)"
        depends on OTG && OTG_MSC
        default "0x15ec"

config OTG_MSC_PRODUCTID
        hex "ProductID (hex value)"
        depends on OTG && OTG_MSC
        default "0xf006"

config OTG_MSC_BCDDEVICE
        hex "bcdDevice (binary-coded decimal)"
        depends on OTG && OTG_MSC
        default "0x0100"

config OTG_MSC_MANUFACTURER
        string "iManufacturer (string)"
        depends on OTG && OTG_MSC
        default "Motorola"

config OTG_MSC_PRODUCT_NAME
        string "iProduct (string)"
        depends on OTG && OTG_MSC
        default "Mass Storage Class - Bulk Only"

#config OTG_MSC_INTF
#        string "MSC Bulk Only iInterface (string)"
#        depends on OTG && OTG_MSC
#        default "MSC BO Data Intf"

config OTG_MSC_DESC
        string "Data Interface iConfiguration (string)"
        depends on OTG && OTG_MSC
        default "MSC BO Configuration"

config OTG_MSC_HOTPLUG
        depends on OTG_MSC && OTG
        bool "start mass storage hotplug"
        default TRUE

config OTG_MSC_REGISTER_TRACE
        bool "  MSC Tracing"
        depends on OTG && OTG_MSC
        default n

config OTG_MSC_NUM_PAGES
        hex "MSC Number of pages per write"
        depends on OTG && OTG_MSC
        default "0x01"
        
endmenu

endmenu
```

## linux-2.6.x/drivers/otg/functions/mtp/Kconfig
```kconfig
# 
# Copyright (c) 2006-2007 Motorola, Inc, All Rights Reserved.
#
# This program is licensed under a BSD license with the following terms:
# 
# Redistribution and use in source and binary forms, with or without modification,
# are permitted provided that the following conditions are met:
#
#   *  Redistributions of source code must retain the above copyright notice,
#      this list of conditions and the following disclaimer.
#   *  Redistributions in binary form must reproduce the above copyright notice,
#      this list of conditions and the following disclaimer in the documentation
#      and/or other materials provided with the distribution.
#   *  Neither the name of Motorola nor the names of its contributors may
#      be used to endorse or promote products derived from this software without
#      specific prior written permission.
# 
# 
# THIS SOFTWARE IS PROVIDED BY THE COPYRIGHT HOLDERS AND CONTRIBUTORS "AS IS" AND
# ANY EXPRESS OR IMPLIED WARRANTIES, INCLUDING, BUT NOT LIMITED TO, THE IMPLIED
# WARRANTIES OF MERCHANTABILITY AND FITNESS FOR A PARTICULAR PURPOSE ARE DISCLAIMED.
# IN NO EVENT SHALL THE COPYRIGHT OWNER OR CONTRIBUTORS BE LIABLE FOR ANY DIRECT,
# INDIRECT, INCIDENTAL, SPECIAL, EXEMPLARY, OR CONSEQUENTIAL DAMAGES (INCLUDING,
# BUT NOT LIMITED TO, PROCUREMENT OF SUBSTITUTE GOODS OR SERVICES; LOSS OF USE, DATA,
# OR PROFITS; OR BUSINESS INTERRUPTION) HOWEVER CAUSED AND ON ANY THEORY OF LIABILITY,
# WHETHER IN CONTRACT, STRICT LIABILITY, OR TORT (INCLUDING NEGLIGENCE OR OTHERWISE)
# ARISING IN ANY WAY OUT OF THE USE OF THIS SOFTWARE, EVEN IF ADVISED OF THE
# POSSIBILITY OF SUCH DAMAGE.
# 
# Changelog:
# Date               Author           Comment
# -----------------------------------------------------------------------------
# 03/28/2006       Motorola         Initial Creation
# 01/09/2007       Motorola         Added menu for PTP(PictSync)
# 
# MTP Kconfig
#

menu "OTG MTP Function"

config OTG_MTP
         tristate "  MTP Function"
         depends on OTG

menu "OTG MTP function options"
	depends on OTG && OTG_MTP

config OTG_MTP_VENDORID
        hex "VendorID (hex value)"
	depends on OTG_MTP && OTG
        default "0x22b8"

config OTG_MTP_PRODUCTID
	depends on OTG_MTP && OTG
        hex "ProductID (hex value)"
        default "0x6415"

config OTG_MTP_BCDDEVICE
	depends on OTG_MTP && OTG
        hex "bcdDevice (binary-coded decimal)"
        default "0x0200"

config OTG_MTP_MANUFACTURER
	depends on OTG_MTP && OTG
        string "iManufacturer (string)"
        default "Motorola Inc."

config OTG_MTP_PRODUCT_NAME
	depends on OTG_MTP && OTG
        string "iProduct (string)"
        default "Motorola Phone"

config OTG_MTP_DESC
	depends on OTG_MTP && OTG
        string "iConfiguration (string)"
        default "MTP Cfg"

config OTG_MTP_HOTPLUG
        depends on OTG_MTP && OTG
        bool "start MTP hotplug"
        default TRUE

endmenu
endmenu


menu "OTG PBG Function"

config OTG_PBG
         tristate "  PBG Function"
         depends on OTG

menu "OTG PBG function options"
	depends on OTG && OTG_PBG

config OTG_PBG_VENDORID
        hex "VendorID (hex value)"
	depends on OTG_PBG && OTG
        default "0x22b8"

config OTG_PBG_PRODUCTID
	depends on OTG_PBG && OTG
        hex "ProductID (hex value)"
        default "0x6411"

config OTG_PBG_BCDDEVICE
	depends on OTG_PBG && OTG
        hex "bcdDevice (binary-coded decimal)"
        default "0x0200"

config OTG_PBG_MANUFACTURER
	depends on OTG_PBG && OTG
        string "iManufacturer (string)"
        default "Motorola Inc."

config OTG_PBG_PRODUCT_NAME
	depends on OTG_PBG && OTG
        string "iProduct (string)"
        default "Motorola Phone"

config OTG_PBG_DESC
	depends on OTG_PBG && OTG
        string "iConfiguration (string)"
        default "PBG Cfg"

config OTG_PBG_HOTPLUG
        depends on OTG_PBG && OTG
        bool "start PBG hotplug"
        default TRUE

endmenu
endmenu


menu "OTG PTP Function"

config OTG_PTP
         tristate "  PTP Function"
         depends on OTG

menu "OTG PTP function options"
	depends on OTG && OTG_PTP

config OTG_PTP_VENDORID
        hex "VendorID (hex value)"
	depends on OTG_PTP && OTG
        default "0x22b8"

config OTG_PTP_PRODUCTID
	depends on OTG_PTP && OTG
        hex "ProductID (hex value)"
        default "0x6411"

config OTG_PTP_BCDDEVICE
	depends on OTG_PTP && OTG
        hex "bcdDevice (binary-coded decimal)"
        default "0x0200"

config OTG_PTP_MANUFACTURER
	depends on OTG_PTP && OTG
        string "iManufacturer (string)"
        default "Motorola Inc."

config OTG_PTP_PRODUCT_NAME
	depends on OTG_PTP && OTG
        string "iProduct (string)"
        default "Motorola Phone"

config OTG_PTP_DESC
	depends on OTG_PTP && OTG
        string "iConfiguration (string)"
        default "PTP Cfg"

config OTG_PTP_HOTPLUG
        depends on OTG_PTP && OTG
        bool "start PBG hotplug"
        default TRUE

endmenu
endmenu
```
