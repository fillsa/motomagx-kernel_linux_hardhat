## linux-2.6.x/drivers/otg/functions/generic/Kconfig
```kconfig
# @(#) balden@seth2.belcarratech.com|otg/functions/generic/Kconfig|20051116204957|00686
#
#      Copyright (c) 2006-2007 Motorola, Inc. 
#
# Changelog:
# Date               Author           Comment
# -----------------------------------------------------------------------------
# 04/26/2006         Motorola         Initial distribution
# 10/18/2006         Motorola         Add Open Src Software language
# 12/11/2006         Motorola         Changes for Open src compliance.
# 04/25/2007         Motorola         Added PTP Configuration.
# 01/09/2007         Motorola         Added PTP Configuration(PictSync)
#
# This Program is distributed in the hope that it will
# be useful, but WITHOUT ANY WARRANTY;
# without even the implied warranty of
# MERCHANTIBILITY or FITNESS FOR A
# PARTICULAR PURPOSE.  See the GNU
# General Public License for more details.

# This program is free software; you can redistribute it
# and/or modify it under the terms of the GNU General
# Public License as published by the Free Software
# Foundation; either version 2 of the License, or (at
# your option) any later version.  You should have
# received a copy of the GNU General Public License
# along with this program; if not, write to the Free
# Software Foundation, Inc., 675 Mass Ave,
# Cambridge, MA 02139, USA

menu "OTG Generic function"
	depends on OTG

config OTG_GENERIC
        tristate "  Generic Function"
        depends on OTG
	---help---
        This acts as a generic function, allowing selection of class
        and interface function drivers to create a specific configuration.

config OTG_GENERIC_HOTPLUG
	bool "start hotplug for usb"
	depends on OTG && OTG_GENERIC
        default TRUE

menu "OTG Generic Composite function options"
	depends on OTG && OTG_GENERIC

config OTG_GENERIC_VENDORID
        hex "VendorID (hex value)"
        depends on OTG && OTG_GENERIC
        default "0x15ec"

config OTG_GENERIC_PRODUCTID
        hex "ProductID (hex value)"
        depends on OTG && OTG_GENERIC
        default "0xf010"

config OTG_GENERIC_BCDDEVICE
        hex "bcdDevice (binary-coded decimal)"
        depends on OTG && OTG_GENERIC
        default "0x0100"

config OTG_GENERIC_MANUFACTURER
        string "iManufacturer (string)"
        depends on OTG && OTG_GENERIC
        default "Belcarra"

config OTG_GENERIC_PRODUCT_NAME
        string "iProduct (string)"
        depends on OTG && OTG_GENERIC
        default "Generic Composite"

config OTG_ACM_NETWORK_PRODUCTID
        hex "ProductID (hex value)"
        depends on OTG 
        default "0x6425"
        
config OTG_ACM_NETWORK_BLAN_DESC   
       string "ACM_BLAN iConfiguration (string)"
       depends on OTG 
       default "Motorola ACM BLAN Configuration"

        
choice
        depends on OTG && OTG_GENERIC
        prompt "Default Composite Driver Configuration"

        config OTG_GENERIC_CONFIG_NONE
        bool 'none'
        help
          No pre-defined selection, use the OTG_GENERIC_CONFIG_NAME instead.

        config OTG_GENERIC_CONFIG_MOUSE
        bool 'mouse'
        help
          Configure the mouse driver in a single function non-composite configuration.


        config OTG_GENERIC_CONFIG_NET_BLAN
        bool 'net-blan'
        help
          Configure the network driver in a single function non-composite BLAN configuration.


        config OTG_GENERIC_CONFIG_NET_CDC
        bool 'net-cdc'
        help
          Configure the network driver in a single function non-composite CDC configuration.

        config OTG_GENERIC_CONFIG_NET_SAFE
        bool 'net-safe'
        help
          Configure the network driver in a single function non-composite SAFE configuration.


        config OTG_GENERIC_CONFIG_ACM_TTY
        bool 'acm-tty'
        help
          Configure the acm driver in a single function non-composite TTY configuration.


        config OTG_GENERIC_CONFIG_MSC
        bool 'msc'
        help
          Configure the msc driver in a single function non-composite configuration.

        config OTG_GENERIC_CONFIG_MTP
        bool 'mtp'
        help
          Configure the mtp driver in a single function non-composite configuration.

        config OTG_GENERIC_CONFIG_PBG
        bool 'pbg'
        help
          Configure the pbg driver in a single function non-composite configuration.

        config OTG_GENERIC_CONFIG_PTP
        bool 'ptp'
        help
          Configure the ptp driver in a single function non-composite configuration.
        
        config OTG_GENERIC_CONFIG_MOUSE2
        bool 'mouse2'
        help
            Configure the mouse driver in a demostration, two function composite configuration.

        config OTG_GENERIC_CONFIG_MSC_MOUSE
        bool 'msc-mouse'
        help
            Configure the msc and mouse driver in a demostration, two function composite configuration.

        config OTG_GENERIC_CONFIG_MOUSE_BLAN
        bool 'mouse-blan'
        help
            Configure the mouse and blan driver in a demostration, two function composite configuration.


        config OTG_GENERIC_CONFIG_MSC_BLAN
        bool 'msc-blan'
        help
            Configure the msc and network-blan driver in a demostration, two function composite configuration.


        config OTG_GENERIC_CONFIG_MSC_CDC
        bool 'msc-cdc'
        help
            Configure the msc and network-cdc driver in a demostration, two function composite configuration.



endchoice

config OTG_GENERIC_CONFIG_NAME
        string "Composite Configuration (string)"
        depends on OTG && OTG_GENERIC && OTG_GENERIC_CONFIG_NONE
        default ""
        ---help---
        Name of predefined configuration to be enabled, note that
        if this is not defined (empty string) then the first available
        configuration will be used (assuming that the required interface
        function drivers are available.

endmenu


endmenu
```

## linux-2.6.x/drivers/otg/functions/isotest/Kconfig
```kconfig
# @(#) balden@seth2.belcarratech.com|otg/functions/isotest/Kconfig|20051116204957|12979
#
#      Copyright (c) 2005-2006 Motorola, Inc.
#
# Changelog:
# Date               Author           Comment
# -----------------------------------------------------------------------------
# 12/12/2005         Motorola         dn Initial distribution
# 10/18/2006         Motorola         ma sk pw Add Open Src Software language
#
# This Program is distributed in the hope that it will
# be useful, but WITHOUT ANY WARRANTY;
# without even the implied warranty of
# MERCHANTIBILITY or FITNESS FOR A
# PARTICULAR PURPOSE.  See the GNU
# General Public License for more details.

# This program is free software; you can redistribute it
# and/or modify it under the terms of the GNU General
# Public License as published by the Free Software
# Foundation; either version 2 of the License, or (at
# your option) any later version.  You should have
# received a copy of the GNU General Public License
# along with this program; if not, write to the Free
# Software Foundation, Inc., 675 Mass Ave,
# Cambridge, MA 02139, USA

menu "OTG ISO Loop Test function"
	depends on OTG

config OTG_ISOTEST
        tristate "  ISO Loop Test Function"
        depends on OTG

menu "OTG ISO Loop Test function options"
	depends on OTG && OTG_ISOTEST

config OTG_ISOTEST_VENDORID
        hex "VendorID (hex value)"
        depends on OTG && OTG_ISOTEST
        default "0x15ec"

config OTG_ISOTEST_PRODUCTID
        hex "ProductID (hex value)"
        depends on OTG && OTG_ISOTEST
        default "0xf004"

config OTG_ISOTEST_BCDDEVICE
        hex "bcdDevice (binary-coded decimal)"
        depends on OTG && OTG_ISOTEST
        default "0x0100"

config OTG_ISOTEST_MANUFACTURER
        string "iManufacturer (string)"
        depends on OTG && OTG_ISOTEST
        default "Belcarra"

config OTG_ISOTEST_PRODUCT_NAME
        string "iProduct (string)"
        depends on OTG && OTG_ISOTEST
        default "ISO Loop Test Storage Class - Bulk Only"

config OTG_ISOTEST_INTF
        string "ISO Loop Test Bulk Only iInterface (string)"
        depends on OTG && OTG_ISOTEST
        default "ISOTEST BO Data Intf"

config OTG_ISOTEST_DESC
        string "Data Interface iConfiguration (string)"
        depends on OTG && OTG_ISOTEST
        default "ISO Loop Test BO Configuration"

endmenu

endmenu
```

## linux-2.6.x/drivers/otg/functions/mouse/Kconfig
```kconfig
# @(#) balden@seth2.belcarratech.com|otg/functions/mouse/Kconfig|20051116204958|01964
#
# Copyright (c) 2005 Motorola, Inc.
#
# Changelog:
# Date               Author           Comment
# -----------------------------------------------------------------------------
# 12/12/2005         Motorola         dn Initial distribution 
#
# This Program is distributed in the hope that it will
# be useful, but WITHOUT ANY WARRANTY;
# without even the implied warranty of
# MERCHANTIBILITY or FITNESS FOR A
# PARTICULAR PURPOSE.  See the GNU
# General Public License for more details.

# This program is free software; you can redistribute it
# and/or modify it under the terms of the GNU General
# Public License as published by the Free Software
# Foundation; either version 2 of the License, or (at
# your option) any later version.  You should have
# received a copy of the GNU General Public License
# along with this program; if not, write to the Free
# Software Foundation, Inc., 675 Mass Ave,
# Cambridge, MA 02139, USA

menu "OTG Random Mouse function"
	depends on OTG

config OTG_MOUSE
        tristate "  Random Mouse Function"
        depends on OTG
	---help---
        This implements a simple Mouse driver that sends HID packets with
        small random movements. This is a good function for initial testing
        of Peripheral Controller Drivers as it provides for a complicated
        enumeration but a simple uni-directional (send Interrupt only) data
        transport.  
   
menu "Mouse support modules:"
	depends on OTG_MOUSE && OTG
 
		
config OTG_MOUSE_INTERFACE
	bool "Build an interface module"
	depends on OTG && OTG_MOUSE
	default "y"
	---help---
	This module needs a composite function module, such as 
	mouse_cf or generic_cf to be activated

config OTG_MOUSE_COMPOSITE
	bool "Build a simple OTG 2.x style composite function with mouse"
	depends on  OTG && OTG_MOUSE && OTG_MOUSE_INTERFACE
	default "n"
	---help---
	This module provides a very simple composite function to drive
	the mouse_if module (see above).  The generic_cf module provides
	a much richer composite function supporting multiple functions.

config OTG_MOUSE_TRADITIONAL
	bool "Build an OTG 1.x style function module/driver"
	depends on OTG && OTG_MOUSE
	default "n"
	---help---
	This is the mouse function driver from previous releases. It 
	does not use the composite/interface mechanism. If this module
	is used, neither of the other two mouse modules is required.

endmenu
 

menu "OTG Random Mouse function options"
	depends on OTG && OTG_MOUSE

config OTG_MOUSE_VENDORID
        hex "VendorID (hex value)"
        depends on OTG && OTG_MOUSE
        default "0x15ec"
	---help---
	This parameter is not used by the mouse_if module because the
	composite layer is responsible for setting this parameter

config OTG_MOUSE_PRODUCTID
        hex "ProductID (hex value)"
        depends on OTG && OTG_MOUSE
        default "0xf003"
	---help---
	Parameters such as PRODUCTID, VENDORID are now the responsibility
	of the composite driver rather than the interface driver. For this
	reason, the module parameters vendor_id, etc are not available in
	the interface versions. Therefore, appropriate values should be set
	in the kernel configuration. These configuration parameters
	are referenced in both mouse_cf and generic_cf. 

config OTG_MOUSE_BCDDEVICE
        hex "bcdDevice (binary-coded decimal)"
        depends on OTG && OTG_MOUSE
        default "0x0100"

config OTG_MOUSE_MANUFACTURER
        string "iManufacturer (string)"
        depends on OTG && OTG_MOUSE
        default "Belcarra"

config OTG_MOUSE_PRODUCT_NAME
        string "iProduct (string)"
        depends on OTG && OTG_MOUSE
        default "Random Mouse Device"

config OTG_MOUSE_COMM_INTF
        string "MOUSE Bulk Only iInterface (string)"
        depends on OTG && OTG_MOUSE
        default "MOUSE Data Intf"

config OTG_MOUSE_DESC
        string "Data Interface iConfiguration (string)"
        depends on OTG && OTG_MOUSE
        default "MOUSE Configuration"

config OTG_MOUSE_BH
        bool "  MOUSE BH Test"
        depends on OTG && OTG_MOUSE
        default n
	---help---
        Implement the Mouse send packet in a bottom half handler,
        this will delay responses to test the PCD works correctly
        when the host polls before a send data urb is queued.

config OTG_MOUSE_PACKETS
        int "Number of packets (zero is continous)"
        depends on OTG && OTG_MOUSE
        default 10
	---help---
        Number of Mouse packets to send, will run
        forever if set to zero.

config OTG_MOUSE_STALL
        bool "  MOUSE Stall Test"
        depends on OTG && OTG_MOUSE
        default n
	---help---
        Periodically stall the INTERRUPT endpoint.
        Used for testing.

config OTG_MOUSE_STALL_COUNT
        int "Number of Stalls"
        depends on OTG && OTG_MOUSE_STALL
        default 1
	---help---
        Number of Stall tests to perform.

config OTG_MOUSE_INTERVAL
        int 'Polling Interval ' 
        depends on OTG && OTG_MOUSE
        default 1
        ---help---
        Sets interrupt endpoint interval.


endmenu


endmenu
```
