## linux-2.6.x/drivers/otg/ocd/brassboard/Kconfig
```kconfig
#
# Copyright (c) 2005 Belcarra
# @(#) balden@seth2.belcarratech.com|otg/ocd/brassboard/Kconfig|20051116204959|07999
#
# Copyright 2006 Motorola, Inc.
#
# Changelog:
# Date               Author           Comment
# -----------------------------------------------------------------------------
# 07/31/2006         Motorola         Initial distribution 
# 10/18/2006         Motorola         Add Open Src Software language
# 12/11/2006         Motorola         Changes for Open src compliance.
#
# This Program is distributed in the hope that it will
# be useful, but WITHOUT ANY WARRANTY;
# without even the implied warranty of
# MERCHANTIBILITY or FITNESS FOR A
# PARTICULAR PURPOSE.  See the GNU
# General Public License for more details.

# This program is free software; you can redistribute it
# and/or modify it under the terms of the GNU General
# Public License as published by the Free Software
# Foundation; either version 2 of the License, or (at
# your option) any later version.  You should have
# received a copy of the GNU General Public License
# along with this program; if not, write to the Free
# Software Foundation, Inc., 675 Mass Ave,
# Cambridge, MA 02139, USA

# CONFIG_OTG_PLATFORM_OTG       # Offer OTG Configuration

# CONFIG_OTG_ISP1104            # Make ISP1104 driver
# CONFIG_OTG_ISP1104_BRASSBOARD  # Compile ISP1104 BRASSBOARD 
# CONFIG_OTG_MC13783_BRASSBOARD    # Compile MC13783 BRASSBOARD 

# CONFIG_OTG_BRASSBOARD_ISP1104  # Use ISP1104
# CONFIG_OTG_BRASSBOARD_MC13783    # Use MC13783
# CONFIG_OTG_BRASSBOARD         # Compile as Traditional USB Peripheral

config OTG_BRASSBOARD
	tristate "Motorola Brassboard"
	depends on OTG
	---help---
	This implements On-The-Go USB Support.
	Ensure that P901 jumper is set to support USB.

choice
	prompt "Select OTG Transceiver"	
	depends on OTG && OTG_BRASSBOARD
	config OTG_BRASSBOARD_ISP1104
		bool 'BaseBoard ISP1104 (NOT IMPLEMENTED)'
		depends on OTG_BRASSBOARD !=n
		---help---
		This will use the Brassboard ISP1104 (ensure that DNP
		resistors are populated and MC13783 DNP resistors are
		not populated.)
	
	config OTG_BRASSBOARD_MC13783
		bool 'Altas Transceiver (Connectivity Driver)'
		depends on OTG_BRASSBOARD !=n
		---help---
		This will use the Freescale MC13783 chip and Freescale
		connectivity driver (ensure that the board is properly
                configured for MC13783 and not the ISP1104.)
	
endchoice

choice
	prompt "Select OTG Transceiver Configuration"	
	depends on OTG && OTG_BRASSBOARD

        config OTG_BRASSBOARD_DIFFERENTIAL_UNIDIRECTIONAL
                bool 'Differential Unidirectional (6 wire)'
                ---help---
                Both the USBOTG and Transceiver need to be configured
                for the data transceiver connection. 
                This selects a Differential Unidirectional 6 wire
                connection.


        config OTG_BRASSBOARD_DIFFERENTIAL_BIDIRECTIONAL
                bool 'Differential Bidirectional (4 wire, STILL TESTING)'
                ---help---
                Both the USBOTG and Transceiver need to be configured
                for the data transceiver connection. 
                This selects a Differential Bidirectional 4 wire
                connection.
                
        config OTG_BRASSBOARD_SINGLE_ENDED_UNIDIRECTIONAL
                bool 'Singled Ended Unidirectional (6 wire, STILL TESTING)'
                ---help---
                Both the USBOTG and Transceiver need to be configured
                for the data transceiver connection. 
                This selects a Single Ended Unidirectional 6 wire
                connection.

        config OTG_BRASSBOARD_SINGLE_ENDED_BIDIRECTIONAL
                bool 'Singled Ended Bidirectional (3 wire)'
                ---help---
                Both the USBOTG and Transceiver need to be configured
                for the data transceiver connection. 
                This selects a Single Ended Bidirectional 3 wire
                connection.


endchoice
choice
        prompt "Select Timer"
        depends on OTG && OTG_BRASSBOARD
		---help---
		Select OTG timer according to platform structure
	
	config OTG_HRT
		depends on HIGH_RES_TIMERS 
		bool 'High Resolution Timer'
		---help---
		Using high resolution timer, if present and enabled (preferred)

#	config OTG_GPTR
#		depends on (HIGH_RES_TIMERS=n)
#		bool 'General Purpose Timer'
#		---help---
#		Using the shared or non-shared general purpose timer
#		Warning: this option is DEPRECATED. Please enable HIGH_RES_TIMERS

endchoice															

if ( OTG_BRASSBOARD != 'n') 

        config OTG_PLATFORM_OTG
                bool 
                default OTG_BRASSBOARD

        config OTG_PLATFORM_USB
                bool 
                default OTG_BRASSBOARD

        config OTG_PLATFORM_USBD
                bool 
                default OTG_BRASSBOARD

        config OTG_FREESCALE
                bool 
                default OTG_BRASSBOARD


        #config OTG_ISP1104
        #        bool
        #        depends on OTG_BRASSBOARD_ISP1104
        #        default OTG_BRASSBOARD

        #config OTG_BRASSBOARD_MC13783_CONNECTIVITY
        #        bool
        #        depends on OTG_BRASSBOARD_MC13783
        #        default OTG_BRASSBOARD

        config OTG_BRASSBOARD_MC13783_POWERIC
                bool
                depends on OTG_BRASSBOARD_MC13783
                default OTG_BRASSBOARD


endif
```

## linux-2.6.x/drivers/otg/ocd/isp1301/Kconfig
```kconfig
# @(#) balden@seth2.belcarratech.com|otg/ocd/isp1301/Kconfig|20051116204959|35532

# Copyright 2005-2006 Motorola, Inc.
#
# Changelog:
# Date               Author           Comment
# -----------------------------------------------------------------------------
# 12/12/2005         Motorola         Initial distribution
# 10/18/2006         Motorola         Add Open Src Software language
# 12/11/2006         Motorola         Changes for Open Src compliance.

# This program is free software; you can redistribute it and/or modify
# it under the terms of the GNU General Public License as published by
# the Free Software Foundation; either version 2 of the License, or
# (at your option) any later version.
#
# This program is distributed in the hope that it will be useful,
# but WITHOUT ANY WARRANTY; without even the implied warranty of
# MERCHANTABILITY or FITNESS FOR A PARTICULAR PURPOSE.  See the
# GNU General Public License for more details.
#
# You should have received a copy of the GNU General Public License
# along with this program; if not, write to the Free Software
# Foundation, Inc., 675 Mass Ave, Cambridge, MA 02139, USA.
#

#menu "Phillips ISP1301 Support"
        config OTG_ISP1301_PROCFS
                depends on OTG_ISP1301 && PROC_FS
                bool "ISP1301 Proc FS debug"
                ---help---
                Compile debug support, implements /proc/isp1301 which
                will display all of the ISP1301 registers.

#endmenu
```

## linux-2.6.x/drivers/otg/ocd/zasevb/Kconfig
```kconfig
#
# @(#) balden@seth2.belcarratech.com|otg/ocd/zasevb/Kconfig|20051117201158|22401
# Copyright (c) 2005 Belcarra
#
# Copyright 2005-2006 Motorola, Inc.
#
# Changelog:
# Date               Author           Comment
# -----------------------------------------------------------------------------
# 12/12/2005         Motorola         Initial distribution 
# 06/12/2006         Motorola         OTG name change 
# 10/18/2006         Motorola         Add Open Src Software language
# 12/12/2006         Motorola         Changes for Open Src compliance.
#
# This program is free software; you can redistribute it and/or modify
# it under the terms of the GNU General Public License as published by
# the Free Software Foundation; either version 2 of the License, or
# (at your option) any later version.
#
# This program is distributed in the hope that it will be useful,
# but WITHOUT ANY WARRANTY; without even the implied warranty of
# MERCHANTABILITY or FITNESS FOR A PARTICULAR PURPOSE.  See the
# GNU General Public License for more details.
#
# You should have received a copy of the GNU General Public License
# along with this program; if not, write to the Free Software
# Foundation, Inc., 675 Mass Ave, Cambridge, MA 02139, USA.


# CONFIG_OTG_PLATFORM_OTG       # Offer OTG Configuration

# CONFIG_OTG_ZASEVB             # Make OMAP driver
# CONFIG_OTG_ISP1301            # Make ISP1301 driver

# CONFIG_OTG_ISP1301_ZASEVB     # Compile ISP1301 ZASEVB 
# CONFIG_OTG_MC13783_ZASEVB       # Compile MC13783 ZASEVB 

# CONFIG_OTG_ZASEVB             # ZASEVB 
# CONFIG_OTG_ZASEVB_ISP1301     # Use ISP1301
# CONFIG_OTG_ZASEVB_MC13783_CONNECTIVITY    # Use MC13783 
# CONFIG_OTG_ZASEVB_MC13783_POWERIC         # Use MC13783
# CONFIG_OTG_PLATFORM           # Compile as OTG Dual-role Device
# CONFIG_OTG_TRADITIONAL        # Compile as Traditional USB Peripheral

config OTG_ZASEVB
	tristate "Freescale ZAS Evaluation Board"
	depends on OTG && (ARCH_MXC27530EVB || MACH_MXC27530EVB || ARCH_I30030EVB || \
    MACH_MXC30030EVB || MACH_MXC30030ADS || MACH_MXC91131EVB || \
    MACH_I30030ADS || MACH_I30030EVB || ARCH_MXC91131)
        ---help---
        This implements On-The-Go USB Support for the ZAS EVB 

choice
	prompt "Select OTG Transceiver"	
	depends on OTG_ZASEVB && (ARCH_MXC91331 || ARCH_MXC91131 || ARCH_MXC91231)
        config OTG_ZASEVB_ISP1301
		bool 'Use the BaseBoard ISP1301 (S2.1 on S2.2 on)'
		depends on OTG_ZASEVB !=n
		---help---
		This will use the ISP1301 on the EVB Base Board.
		Switch 2-1 and  switch 2-2 should both be in the ON position.

                SW2.1 ON
                SW2.2 ON

        
        config OTG_ZASEVB_MC13783_LEGACY
                bool 'Use the  MC13783 Transceiver (check setting in help)'
                #depends on OTG_ZASEVB !=n
                depends on OTG_ZASEVB && (ARCH_MXC91331 || ARCH_MXC91231 || \
                MACH_MXC30030ADS || MACH_MXC30030EVB || \
                MACH_I30030ADS || MACH_I30030EVB || MACH_MXC27530EVB) && \
                (MXC_MC13783_CONNECTIVITY || MC13783_CONNECTIVITY)
                ---help---
                This will use the Freescale MC13783 and the Freescale Connectivity driver.
                For BrassBoard works without any special settings.

                For ZAS EVB with MC13783 daughter card, Switch 2-1 should be on, Switch 2-2
                should be off.
                If you are using MC13783 daughter card with MXC91231 or MXC275-30 EVB,
                you should set S6.1: OFF and S6.2: ON.
                If you are using MC13783 daughter card with MXC91321
                or MXC91331 or i.300-30 EVB  or MXC300-30 EVB, you should set S6.1: ON and
                S6.2: OFF.

#        config OTG_ZASEVB_PMIC
#               bool 'Use the sc55112 Transceiver'
#        	#depends on OTG_ZASEVB !=n
#                depends on OTG_ZASEVB && ARCH_MXC91131 && MACH_MXC91131EVB
#        	---help---
#           This will use the Freescale sc55112 and the Freescale Connectivity driver.
#
#

endchoice
choice
        prompt "Select OTG Transceiver Configuration"        
        depends on OTG && OTG_ZASEVB

        config OTG_ZASEVB_DIFFERENTIAL_UNIDIRECTIONAL
                bool 'Differential Unidirectional (6 wire)'
                depends on (ARCH_MXC91331 || ARCH_MXC91321)
                ---help---
                Both the USBOTG HWMODE and Transceiver need to be configured
                for the data transceiver connection. 

                This selects a Differential unidirectional 6 wire connection.

		On MC13783 daughter board
                SW4.1 = OFF
                SW4.2 = OFF
                SW4.3 = OFF
                SW4.4 = ON
								

        config OTG_ZASEVB_DIFFERENTIAL_BIDIRECTIONAL
                bool 'Differential Bidirectional (4 wire)'
                depends on ARCH_MXC91231 || ARCH_MXC91131
                ---help---
                Both the USBOTG HWMODE and Transceiver need to be configured
                for the data transceiver connection. 

                This selects a Differential bidirectional 4 wire connection.
                
        config OTG_ZASEVB_SINGLE_ENDED_UNIDIRECTIONAL
                bool 'Singled Ended Unidirectional (6 wire)'
                depends on (ARCH_MXC91331 || ARCH_MXC91321)
                ---help---
                Both the USBOTG HWMODE and Transceiver need to be configured
                for the data transceiver connection. 

                This selects a Single-Ended unidirectional 6 wire connection.

        config OTG_ZASEVB_SINGLE_ENDED_BIDIRECTIONAL
                bool 'Singled Ended Bidirectional (3 wire)'
                depends on ARCH_MXC91231 || ARCH_MXC91131
                ---help---
                Both the USBOTG HWMODE and Transceiver need to be configured
                for the data transceiver connection.

		On MC13783 daughter board
		SW4.1 = OFF
		SW4.2 = OFF or ON (different from data sheet !!)
		SW4.3 = OFF
		SW4.4 = ON

                This selects a Single-Ended bidirectional 3 wire connection.

endchoice
choice
        prompt "Select Timer"
        depends on OTG && OTG_ZASEVB
		---help---
		Select OTG timer according to platform structure
	
	config OTG_HRT
		depends on HIGH_RES_TIMERS 
		bool 'High Resolution Timer'
		---help---
		Using high resolution timer, if present and enabled (preferred)

#	config OTG_GPTR
#		depends on (HIGH_RES_TIMERS=n)
#		bool 'General Purpose Timer'
#		---help---
#		Using the shared or non-shared general purpose timer
#		Warning: this option is DEPRECATED. Please enable HIGH_RES_TIMERS

endchoice															

if ( OTG_ZASEVB != 'n') 

        config OTG_PLATFORM_OTG
                bool 
                default OTG_ZASEVB

        config OTG_PLATFORM_USB
                bool 
                default OTG_ZASEVB

        config OTG_PLATFORM_USBD
                bool 
                default OTG_ZASEVB

        #config OTG_HIGH_SPEED
        #        bool
        #        default OTG_ZASEVB

        config OTG_FREESCALE
                bool 
                default OTG_ZASEVB


        config OTG_ISP1301
                bool
                depends on OTG_ZASEVB_ISP1301
                default OTG_ZASEVB

        config OTG_ZASEVB_MC13783_CONNECTIVITY
                bool
                depends on OTG_ZASEVB_MC13783_LEGACY
                default OTG_ZASEVB

        config OTG_ZASEVB_MC13783_LEGACY_POWERIC
                bool
                depends on OTG_ZASEVB_MC13783_LEGACY
                default OTG_ZASEVB

endif
```
