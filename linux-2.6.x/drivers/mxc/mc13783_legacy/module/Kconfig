## linux-2.6.x/drivers/power_ic/core/Kconfig
```kconfig
# Copyright (C) 2005-2007 Motorola, Inc.
#
#  This program is free software; you can redistribute it and/or modify
#  it under the terms of the GNU General Public License version 2 as
#  published by the Free Software Foundation.
#
#  This program is distributed in the hope that it will be useful,
#  but WITHOUT ANY WARRANTY; without even the implied warranty of
#  MERCHANTABILITY or FITNESS FOR A PARTICULAR PURPOSE.  See the
#  GNU General Public License for more details.
#
#  You should have received a copy of the GNU General Public License
#  along with this program; if not, write to the Free Software
#  Foundation, Inc., 59 Temple Place, Suite 330, Boston, MA  02111-1307  USA
#
# Motorola 2007-Jan-17 - Maxim MAX6946 LED Controller support
# Motorola 2006-Oct-30 - Maxim MAX7314 LED Controller support
# Motorola 2006-Oct-06 - Update File
# Motorola 2006-Sep-29 - Ceramic Speaker Support
# Motorola 2006-Aug-03 - Linear Vibrator Support
# Motorola 2006-Jun-22 - Remove MOT_POWER_IC dependencies
# Motorola 2005-Mar-25 - File re-written from scratch

menu "Power IC support"

config MOT_POWER_IC
    tristate "Motorola Power IC"
    ---help---
    This configuration enables the Power IC to be used by SCM-A11 and Zeus

config MOT_POWER_IC_ATLAS
    tristate "Motorola Power IC"
    depends on MOT_POWER_IC
    ---help---
    This configuration enables the Atlas to be used by SCM-A11 without affecting EzX

config MOT_FEAT_MAX6946
    tristate "Maxim MAX6946 LED Controller support"
    depends on MOT_POWER_IC
    ---help---
    This configuration enables Maxim MAX6946 LED Controller support for all platforms

config MOT_FEAT_MAX7314
    tristate "Maxim MAX7314 LED Controller support"
    depends on MOT_POWER_IC
    ---help---
    This configuration enables Maxim MAX7314 LED Controller support for all platforms

config LINEARVIBRATOR
    tristate "Linear Vibrator support"
    default n
    ---help---
    This configuration enables the linear vibrator for all platforms

config CERAMICSPEAKER
    tristate "Ceramic Speaker support"
    default n
    ---help---
    This configuration enables the ceramic speaker for all platforms
endmenu
```

## linux-2.6.x/drivers/profiler/Kconfig
```kconfig
#
# Profiler configuration
#

menu "profiler support"

config PROFILER
	bool

endmenu
```

## linux-2.6.x/drivers/video/mxc/Kconfig
```kconfig
config FB_MXC
	tristate "MXC Framebuffer support"
	depends on FB && MXC_IPU
	default y
	help
	  This is a framebuffer device for the MXC LCD Controller.
	  See <http://www.linux-fbdev.org/> for information on framebuffer
	  devices.

	  If you plan to use the LCD display with your MXC system, say
	  Y here.

choice
	prompt "Default Framebuffer Bit Depth"
	depends on FB_MXC
	default FB_MXC_24BPP

config FB_MXC_16BPP
	bool "16 BPP"

config FB_MXC_24BPP
	bool "24 BPP"

config FB_MXC_32BPP
	bool "32 BPP"

endchoice

config FB_MXC_SYNC_PANEL
	depends on FB_MXC
	bool "Synchronous Panels"
	default y

choice
	prompt "Synchronous Panel Type"
	depends on FB_MXC_SYNC_PANEL && FB_MXC
	default FB_MXC_SHARP_QVGA_PANEL

config FB_MXC_SANYO_QVGA_PANEL
	bool "Sanyo QVGA Panel"

config FB_MXC_SHARP_QVGA_PANEL
	bool "Sharp QVGA Panel"

config FB_MXC_VGA_PANEL
	bool "VGA Panel"

config FB_MXC_TVOUT
	bool "TV Out Encoder"

endchoice

choice
	prompt "TV-Out Video Standard"
	depends on FB_MXC_TVOUT
	default FB_MXC_TVOUT_VGA

config FB_MXC_TVOUT_NTSC
	bool "NTSC"

config FB_MXC_TVOUT_PAL
	bool "PAL"

config FB_MXC_TVOUT_VGA
	bool "VGA"

endchoice

config FB_MXC_OVERLAY
	bool "Framebuffer Overlay Plane"
	depends on FB_MXC_SYNC_PANEL
	default n

config FB_MXC_INTERNAL_MEM
	bool "Framebuffer in Internal RAM"
	depends on FB_MXC_SYNC_PANEL && !FB_MXC_VGA_PANEL && ARCH_MXC91231
	depends on !FB_MXC_32BPP
	default n

config FB_MXC_ASYNC_PANEL
	depends on FB_MXC
	bool "Asynchronous Panels"
	default n

menu "Asynchronous Panel Type"
	depends on FB_MXC_ASYNC_PANEL && FB_MXC

config FB_MXC_EPSON_PANEL
	depends on FB_MXC_ASYNC_PANEL
	default n
	bool "Epson 176x220 Panel"

if MACH_I30030ADS
config FB_MXC_EPSON_QVGA_PANEL
	depends on FB_MXC_ASYNC_PANEL
	default y
	bool "Epson 240x320 Panel"
endif

if MACH_MXC30030ADS
config FB_MXC_TOSHIBA_QVGA_PANEL
	depends on FB_MXC_ASYNC_PANEL
	bool "Toshiba 240x320 Panel"

config FB_MXC_SHARP_128_PANEL
	depends on FB_MXC_ASYNC_PANEL
	bool "Sharp 128x128 Panel"
endif

endmenu

choice
	prompt "Async Panel Interface Type"
	depends on FB_MXC_ASYNC_PANEL && FB_MXC
	default FB_MXC_ASYNC_PANEL_IFC_16_BIT

config FB_MXC_ASYNC_PANEL_IFC_8_BIT
	bool "8-bit Parallel Bus Interface"

config FB_MXC_ASYNC_PANEL_IFC_16_BIT
	bool "16-bit Parallel Bus Interface"

config FB_MXC_ASYNC_PANEL_IFC_SERIAL
	bool "Serial Bus Interface"

endchoice

choice
        prompt "Main-Display Type"
        default FB_MXC_MAIN_TRANSMISSIVE_DISPLAY

config FB_MXC_MAIN_TRANSMISSIVE_DISPLAY
        bool "Transmissive Display"

config FB_MXC_MAIN_TRANSFLECTIVE_DISPLAY
        bool "Transflective Display"

endchoice

choice
        prompt "CLI-Display Type"
        default FB_MXC_CLI_TRANSFLECTIVE_DISPLAY

config FB_MXC_CLI_TRANSMISSIVE_DISPLAY
        bool "Transmissive Display"

config FB_MXC_CLI_TRANSFLECTIVE_DISPLAY
        bool "Transflective Display"

endchoice
```

## linux-2.6.x/ktools/Kconfig
```kconfig
menu "MontaVista System tools"

config ILATENCY
       bool "Interrupt Latency Instrumentation"
       default n
       depends on !CRITICAL_IRQSOFF_TIMING && !KFI && !MOT_FEAT_32KHZ_GPT
       help
         This option turns on instrumentation in the kernel to measure the
         interrupt overhead and interrupt hold off times of the kernel and
         driver set for a particular system.  The measurement provides
         interrupt latency data to gain an understanding of what interrupt
         latencies look like for that system.

	 This instrumentation is mutually exclusive to CRITICAL_IRQSOFF_TIMING
         and Kernel Functional Instrumentation.
	 If you are analyzing interrupt latency and off times with DevRocket
	 you must use Interrupt Latency Instrumentation (ILATENCY).

         The data is collected in /proc/ilatcurve, outlier data, or the
         maximum interrupt off offenders are collected in /proc/imaxoff.  This
         file has the longest interrupt off times and the file and line number
         of the interrupt off/on pair.  This file is useful for finding and
         debugging drivers that have poor interrupt latencies.

         Interrupt Latency Instrumentation should NOT be used in production
         systems.  It has a fairly large overhead to measure and collect the
         data.  It also should not be used with kernel preemption latency
         times collection as they will interfere with each other.

	 To set the interrupt latency timer speed pass tpu=XXX
	 on the command line, where XXX is the rate of the timer.  
	 If you do not know the rate of the timer being used on your system 
	 for interrupt latency measurement say N
	 to this feature.

         Say Y to this option if you are trying to understand the interrupt
         latency curve of your board.  This should be only used in the design
         and debug phase of your product.

config START_TMU1
	bool 
	default y
	depends on ILATENCY && SUPERH

config KFI
       bool "Kernel Function Instrumentation"
       default n
       help
         Say Y here to enable kernel function instrumentation.  This feature
         is used to measure boot times. The instrumentation shows the
         functions called in the boot path, for example, and the time
         spent in each function.

         Kernel Function Instrumentation is mutually exclusive with Interrupt
         Latency Instrumentation.  Turning on Kernel Function Instrumentation
         will turn off Interrupt Latency Instrumentation automatically.

         Say N if you are not timing the boot sequence, this feature produces
         a large performance penalty and is NOT intended for production
         code or systems that will be used in measuring ANY aspect of
         system performance. KFI and ILATENCY are mutually exclusive.

config KFI_BOOT_TIMING
       depends on KFI
       bool "  Measure boot time to user space"
         help
         Say Y here if you have wish to use the default
         static config file that measures boot time to user space.

config PRIORITIZED_OOM_KILL
       bool "User prioritizable oom killer"
       help
         Say Y here ro enable the prioritizable oom kill functions.
         This option allows the super user to set 2 lists in the /proc file
         system that control which processes are killed first and which
         processes are NOT to be killed.  The /proc/sys/kernel/oom/dontkill
         file has a list of process names that are NOT to be kill by the OOM
         killer.  The /proc/sys/kernel/oom/killable file contains a list of
         processes that can be killed in situations of extreme low memory.
         The list is prioritzed in FIFO fashion.  The first entry in the list
         is the first OOM victim.

         Both files can be erased by passing the word 'erase' to the file.
         E.g. echo erase > /proc/sys/kernel/oom/killable

         Typical processes that are added to the don't kill list may include,
         init, bash, portmap, keventd, kswapd, etc.


endmenu
```
