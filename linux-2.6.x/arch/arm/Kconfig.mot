## linux-2.6.x/arch/arm/mach-mx3/Kconfig
```kconfig
menu "MX3 Options"
	depends on ARCH_MX3

config MACH_MX31ADS
	bool "Support MX31ADS platforms"
	default y
	help
	  Include support for MX31ADS platform. This includes specific
	  configurations for the board and its peripherals.

config VIRTIO_SUPPORT
	bool "Only works Virtio"
	help
	  Turn on this option to assume working with Virtio.
	  Leaving this option off assume working with hardware EVBs.

config MX3_DOZE_DURING_IDLE
	bool "Enter Doze mode during idle"
	help
	  Turning on this option will put the CPU into Doze mode during idle.
	  The default is to enter Wait mode during idle. Doze mode during
	  idle will save additional power over Wait mode.

endmenu
```

## linux-2.6.x/arch/arm/mach-mxc91131/Kconfig
```kconfig
menu "MXC91131 Options"
	depends on ARCH_MXC91131

config MACH_MXC91131EVB
	bool "Support MXC91131 EVB platforms"
	default y
	help
	  Include support for MXC91131 EVB platform. This includes specific
	  configurations for the board and its peripherals.

endmenu
```

## linux-2.6.x/arch/arm/mach-mxc91231/Kconfig
```kconfig
menu "MXC91231 Options"
	depends on ARCH_MXC91231

config MACH_MXC27530EVB
	bool "Support MXC275-30 EVB platforms"
	default n
	help
	  Include support for MXC275-30 EVB platform. This includes specific
	  configurations for the board and its peripherals.

config MACH_SCMA11PHONE
        bool "Support Motorola SCM-A11-based Phones"
        default n
#LJ7.1     depends on MOT_FEAT_POWER_IC_API
        help
          Include support for Motorola products based on the SCM-A11 SOC.

menu "Motorola SCM-A11 Products"
        depends on MACH_SCMA11PHONE

config MACH_SCMA11REF
	bool "Support the SCM-A11 Reference platform"
	help
	  Include support for the SCM-A11 Reference platform. This includes 
	  specific configurations for the board and its peripherals.

config MACH_ASCENSION
	bool "Support Motorola Product: ascension"
	help
	  Include support for Motorola Product: ascension. This includes 
	  specific configurations for the board and its peripherals.

config MACH_LIDO
	bool "Support Motorola Product: lido"
	help
	  Include support for Motorola Product: lido. This includes 
	  specific configurations for the board and its peripherals.

config MACH_SAIPAN
	bool "Support Motorola Product: saipan"
	help
	  Include support for Motorola Product: saipan. This includes 
	  specific configurations for the board and its peripherals.

config MACH_ELBA
	bool "Support Motorola Product: elba"
	help
	  Include support for Motorola Product: elba. This includes 
	  specific configurations for the board and its peripherals.

config MACH_PIANOSA
	bool "Support Motorola Product: pianosa"
	help
	  Include support for Motorola Product: pianosa. This includes 
	  specific configurations for the board and its peripherals.

config MACH_PICO
	bool "Support Motorola Product: pico"
	help
	  Include support for Motorola Product: pico. This includes 
	  specific configurations for the board and its peripherals.

config MACH_MARCO
	bool "Support Motorola Product: marco"
	help
	  Include support for Motorola Product: marco. This includes 
	  specific configurations for the board and its peripherals.

config MACH_XPIXL
	bool "Support Motorola Product: xpixl"
	help
	  Include support for Motorola Product: xpixl. This includes 
	  specific configurations for the board and its peripherals.

config MACH_NEVIS
	bool "Support Motorola Product: nevis"
	help
	  Include support for Motorola Product: nevis. This includes 
	  specific configurations for the board and its peripherals.

comment 'End of Motorola SCM-A11 Products'

endmenu

endmenu
```

## linux-2.6.x/arch/arm/mach-mxc91321/Kconfig
```kconfig
menu "MXC91331 Options"
	depends on ARCH_MXC91331

choice
	prompt "Board type"
	default MACH_I30030EVB

config MACH_I30030EVB
	bool "Support i.300-30 EVB platforms"
	help
	  Include support for i.300-30 EVB platform. This includes specific
	  configurations for the board and its peripherals.

config MACH_I30030ADS
	bool "Support i.300-30 ADS platforms"
	help
	  Include support for i.300-30 ADS platform. This includes
          specific configurations for the board and its peripherals.

endchoice

choice
	prompt "i.300-30 ADS Options"
	default MACH_I30030EVB_VER52A
        depends on MACH_I30030ADS

config MACH_I30030ADS_VER52
        bool "Support for PCB version 52"
        help
          Turn on this option to support board version 52.

config MACH_I30030ADS_VER52A
        bool "Support for PCB version 52A"
        help
          Turn on this option to support board version 52A.

endchoice
endmenu

menu "MXC91321 Options"
	depends on ARCH_MXC91321

choice
	prompt "Board type"
	default MACH_MXC30030EVB

config MACH_MXC30030EVB
	bool "Support MXC300-30 EVB platforms"
	help
	  Include support for MXC300-30 EVB platform. This includes specific
	  configurations for the board and its peripherals.


config MACH_MXC30030ADS
	bool "Support MXC300-30 ADS platforms"
	help
	  Include support for MXC300-30 ADS platform. This includes specific
	  configurations for the board and its peripherals.

config MACH_ARGONLVPHONE
        bool "Support Motorola ArgonLV-based Phones"
        default n
        help
          Include support for Motorola products based on the ArgonLV SOC.

endchoice

menu "Motorola ArgonLV Products"
        depends on MACH_ARGONLVPHONE

config MACH_ARGONLVREF
	bool "Support ArgonLV Reference platform"
        default n
	help
          Include support for the ArgonLV-based LJ7.1 Reference Platform.

config MACH_BUTEREF
        bool "Support deprecated BUTE platform"
        default n
        depends on MACH_ARGONLVREF
        help
	  Include support for the Bute P3 brassboard, P4 wingboard,
          P4 closed-phone, and P5 closed-phone.

config MACH_KEYWEST
        bool "Support Motorola product: Key West"
        default n
        help
            Include support for the Key West product.

config MACH_KASSOS
        bool "Support Motorola product: Kassos"
        default n
        help
            Include sypport for the Kassos product.

config MACH_PAROS
        bool "Support Motorola product: Paros"
        default n
        help
            Include sypport for the Paros product.

endmenu

endmenu
```

## linux-2.6.x/arch/arm/mach-pnx4008/Kconfig
```kconfig
if ARCH_PNX4008

menu "PNX4008 Options"

comment "PNX4008 features"

config PNX4008_GPIO_COMPAT
	bool "Compatibility interface with Philips GPIO"
	depends on ARCH_PNX4008
    	help
	   Compatibility interface with Philips GPIO. Say y here to enable
	   if you want to use precompiled (binary) modules from Philips 
	   Semiconductors since they expect this GPIO API.
	   Say y if unsure.

endmenu

endif
```

## linux-2.6.x/arch/arm/plat-mxc/Kconfig
```kconfig
if ARCH_MXC

menu "Freescale MXC Implementations"

choice
	prompt "MXC/iMX System Type"
	default ARCH_MXC91321

config ARCH_MXC91331
	bool "MXC91331-based"
	select YAFFS_MXC_MODE
	select MXC_DSP_BRINGUP

config ARCH_MXC91321
	bool "MXC91321-based"
	select YAFFS_MXC_MODE
	select MXC_DSP_BRINGUP

config ARCH_MXC91231
	bool "MXC91231-based"
	select YAFFS_MXC_MODE
	select MXC_DSP_BRINGUP

config ARCH_MXC91131
	bool "MXC91131-based"
	select YAFFS_MXC_MODE
	select MXC_DSP_BRINGUP

config ARCH_MX3
	bool "MX31-based"
	select YAFFS_MXC_MODE
	help
	  This enables support for systems based on Freescale i.MX31

endchoice

source "arch/arm/mach-mx3/Kconfig"

source "arch/arm/mach-mxc91321/Kconfig"

source "arch/arm/mach-mxc91231/Kconfig"

source "arch/arm/mach-mxc91131/Kconfig"

endmenu

config MXC_DSP_BRINGUP
	bool

endif
```

## linux-2.6.x/arch/i386/kernel/cpu/dpm/Kconfig
```kconfig
#
# Dynamic Power Management
#

source "drivers/dpm/Kconfig"

config DPM_CENTRINO
       tristate "DPM (Dynamic Power Management) for Intel Centrino Enhanced Speedstep"
       depends on DPM
       default n

config DPM_DUMMY
       tristate "Dummy DPM (Dynamic Power Management) for MVL ADK"
       depends on DPM
       default n
```

## linux-2.6.x/drivers/aplogger/Kconfig
```kconfig
#########################################################
##  File: Kconfig - AP Datalogger module hook compile config file
##
##        Copyright 2006 Motorola, Inc.
##
## This program is free software; you can redistribute it and/or modify
## it under the terms of the GNU General Public License as published by
## the Free Software Foundation; either version 2 of the License, or
## (at your option) any later version.
##
## This program is distributed in the hope that it will be useful,
## but WITHOUT ANY WARRANTY; without even the implied warranty of
## MERCHANTABILITY or FITNESS FOR A PARTICULAR PURPOSE.  See the
## GNU General Public License for more details.
##
## You should have received a copy of the GNU General Public License
## along with this program; if not, write to the Free Software
## Foundation, Inc., 675 Mass Ave, Cambridge, MA 02139, USA.
##
#########################################################/

# Revision History
#
#  #   Date         Author          Comment
# === ==========   ============    ============================
#   1 10/03/2006    Motorola        Initial version. 
#


#
# AP Logger Module Options
#
menu "AP Logger Hooks"

config APLOGGER
	bool "AP Logger Kernel Hooks"
	default n
	help
        This option will compile the AP datalogger module
        hooks directly into the kernel. This is needed if
        you plan on compiling the AP datalogger module. 
        If unsure, choose 'N'.

endmenu
```

## linux-2.6.x/drivers/dpm/Kconfig
```kconfig
#
# Dynamic Power Management
#

menu "Dynamic Power Management"

config DPM
	bool "Dynamic Power Management"
	help
	  Enable Dynamic Power Management, if implemented for your platform.
	  DPM conserves power by adjusting power parameters according to
	  system state (such as idle, running a high-power-usage task, etc.)
	  and enables associated power management features such as device
	  constraints on power parameters.  DPM relies on power policy and
	  machine-dependent power operating points and such to be configured
	  from userspace after boot.

	  If in doubt, say N.

config DPM_STATS
	bool "  Enable DPM Statistics Gathering"
	depends on DPM
	help
	  This enables gathering and reporting statistics for DPM.
	  This can be useful during development of DPM platform code or
	  in other situations where information on the operation of DPM is
	  needed.

	  If in doubt, say N.


config DPM_PROCFS
	bool "  Enable old DPM /proc interface (deprecated)"
	depends on DPM && PROC_FS
	help
	  This enables the /proc/driver/dpm interface for controlling
	  DPM.  Please note that it is recommended to use the sysfs
	  interface instead (which is built automatically).

	  If in doubt, say N.

endmenu
```

## linux-2.6.x/drivers/evb/Kconfig
```kconfig
#
# Event Broker
#

menu "Event Broker"

config EVENT_BROKER
	bool "Event Broker"
	help
	  Enable Event Broker.
	  Event Broker is a publish and subscribe eventing mechanism. 
	  Both kernel and user-level components are allowed to define 
	  classes of events, subscribe to events and publish events. 
	  It is based on the one sender many receivers principle. 
	  It also defines the concept of event groups with remote 
          access capabilities to share events between systems.

	  If in doubt, say N.

endmenu
```

## linux-2.6.x/drivers/media/video/mxc/capture/Kconfig
```kconfig
menu "MXC Camera/V4L2 PRP Features support"
config MXC_CAMERA_MICRON111
        tristate "micron mt9v111 camera support"
        depends on (VIDEO_MXC_CAMERA && I2C_MXC && (!MACH_I30030ADS) && (!MACH_MXC30030ADS))
    default y
        help
          If you plan to use the mt9v111 Camera with your MXC system, say Y here.

config MXC_CAMERA_S5K3AAEX
        tristate "sumsung s5k3aaex camera support"
        depends on (VIDEO_MXC_CAMERA && I2C_MXC && (MACH_I30030ADS || MACH_MXC30030ADS))
    default n
        help
          If you plan to use the s5k3aaex Camera with your MXC system, say Y here. Will be replaced by Magna hv7161.

config MXC_CAMERA_HV7161
        tristate "Magna Hv7161 camera support"
        depends on (VIDEO_MXC_CAMERA && I2C_MXC && (MACH_I30030ADS || MACH_MXC30030ADS))
    default y
        help
          If you plan to use the magna hv7161 Camera with your MXC system, say Y here.

config MXC_IPU_PRP_VF_SDC
	tristate "Pre-Processor VF SDC library"
        depends on (VIDEO_MXC_CAMERA && MXC_IPU && FB_MXC_SYNC_PANEL && (MXC_CAMERA_MICRON111 || MXC_CAMERA_S5K3AAEX || MXC_CAMERA_HV7161))
    default y
	help
           Use case PRP_VF_SDC:
              Preprocessing image from smart sensor for viewfinder and
              displaying it on synchronous display with SDC use case.
              If SDC BG is selected, Rotation will not be supported.
                CSI -> IC (PRP VF) -> MEM
                MEM -> IC (ROT) -> MEM
                MEM -> SDC (FG/BG)

config MXC_IPU_PRP_VF_ADC
	tristate "Pre-Processor VF ADC library"
        depends on (VIDEO_MXC_CAMERA && MXC_IPU && FB_MXC_ASYNC_PANEL && (MXC_CAMERA_MICRON111 || MXC_CAMERA_S5K3AAEX || MXC_CAMERA_HV7161))
    default y
	help
           Use case PRP_VF_ADC:
              Preprocessing image from smart sensor for viewfinder and
              displaying it on asynchronous display.
                CSI -> IC (PRP VF) -> ADC2

config MXC_IPU_PRP_ENC
	tristate "Pre-processor Encoder library"
        depends on (VIDEO_MXC_CAMERA && MXC_IPU && (MXC_CAMERA_MICRON111 || MXC_CAMERA_S5K3AAEX || MXC_CAMERA_HV7161))
    default y
	help
           Use case PRP_ENC:
              Preprocessing image from smart sensor for encoder.
                CSI -> IC (PRP ENC) -> MEM

endmenu
```

## linux-2.6.x/drivers/mxc/Kconfig
```kconfig
# drivers/video/mxc/Kconfig

if ARCH_MXC

menu "MXC support drivers"

source "drivers/mxc/ipu/Kconfig"
source "drivers/mxc/spi/Kconfig"
source "drivers/mxc/ssi/Kconfig"
source "drivers/mxc/dam/Kconfig"
source "drivers/mxc/sc55112/Kconfig"
source "drivers/mxc/pm/Kconfig"
source "drivers/mxc/security/Kconfig"
source "drivers/mxc/sdma/Kconfig"
source "drivers/mxc/hmp4e/Kconfig"
source "drivers/mxc/apal/Kconfig"
endmenu

endif
```

## linux-2.6.x/drivers/mxc/apal/Kconfig
```kconfig
# 
# Copyright (C) 2005-2006  Motorola, Inc.
#

#
# APAL (Audio Driver) configuration
#

menu "APAL (Audio Driver) support"


config APAL
	tristate "APAL support"
	---help---
	  Say Y to get the APAL (Audio Driver) available on MXC platform. 

endmenu
```

## linux-2.6.x/drivers/mxc/hmp4e/Kconfig
```kconfig
#
# MPEG4 Encoder kernel module  configuration
#

menu "MXC MPEG4 Encoder Kernel module support"

config MXC_HMP4E
	tristate "MPEG4 Encoder support"
	depends on ARCH_MXC
	depends on !ARCH_MXC91131
	depends on !ARCH_MXC91231
	---help---
	  Say Y to get the MPEG4 Encoder kernel module available on MXC platform.

endmenu
```

## linux-2.6.x/drivers/mxc/ipu/Kconfig
```kconfig
menu "MXC IPU"

config MXC_IPU
	bool "MXC Image Processing Unit"
	depends on ARCH_MXC
	help
	  If you plan to use the Image Processing unit in the MXC, say
	  Y here. If unsure, select Y.

source "drivers/mxc/ipu/pf/Kconfig"
source "drivers/mxc/ipu/pp/Kconfig"

endmenu
```

## linux-2.6.x/drivers/mxc/ipu/pf/Kconfig
```kconfig
config MXC_IPU_PF
	tristate "MXC MPEG4/H.264 Post Filter Driver"
	depends on MXC_IPU
    default y
	help
        Driver for MPEG4 dering and deblock and H.264 deblock
        using MXC IPU h/w
config MOT_FEAT_IPU_PF_PERM666
	bool "set MXC MPEG4/H.264 Post Filter Driver permission to rw-rw-rw-"
	depends on MXC_IPU_PF
    default n
	help
        Driver for MPEG4 dering and deblock and H.264 deblock
        using MXC IPU h/w with permission rw-rw-rw-
```

## linux-2.6.x/drivers/mxc/ipu/pp/Kconfig
```kconfig
config MOT_FEAT_IPU_PP
	tristate "MXC Post Processing Driver"
	depends on MXC_IPU
    default n
	help
        Driver for rotation, color space conversion, resizing, downsizing
        using MXC IPU h/w
```
